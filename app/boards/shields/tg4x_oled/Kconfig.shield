## app/boards/shields/tg4x_oled/Kconfig.shield
```kconfig
# Copyright (c) 2020 The ZMK Contributors
# SPDX-License-Identifier: MIT

config SHIELD_TG4X_OLED
	def_bool $(shields_list_contains,tg4x_oled)
```
