/*
 * Copyright (c) 2020 The ZMK Contributors
 *
 * SPDX-License-Identifier: MIT
 */

&spi1 {
	compatible = "nordic,nrf-spim";
	/* Cannot be used together with i2c0. */
	status = "okay";
	mosi-pin = <8>;
	// Unused pins, needed for SPI definition, but not used by the ws2812 driver itself.
	sck-pin = <28>;
	miso-pin = <43>;

	led_strip: ws2812@0 {
		compatible = "worldsemi,ws2812-spi";
		label = "WS2812";

		/* SPI */
		reg = <0>; /* ignored, but necessary for SPI bindings */
		spi-max-frequency = <4000000>;

		/* WS2812 */
		chain-length = <7>; /* number of LEDs */
		spi-one-frame = <0x70>;
		spi-zero-frame = <0x40>;
	};
};

/ {
	chosen {
		zmk,underglow = &led_strip;
	};
};